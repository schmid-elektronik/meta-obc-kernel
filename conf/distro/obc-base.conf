## conf/distro/obc-base.conf
```bitbake
require conf/distro/include/obc-distro.inc

DISTRO = "obc-base"

DISTRO_NAME = "OBC nextGen Base"
DISTRO_VERSION = "1.1.12"
DISTRO_CODENAME = "2020-11"

DISTRO_FEATURES_remove = " \
                          gobject-introspection-data \
                          pulseaudio \
                          alsa \
"
DISTRO_FEATURES_BACKFILL_CONSIDERED += " \
                                        gobject-introspection-data \
                                        pulseaudio \
"


# Machine config..?
BOOTFS_PARTITION_SIZE = "32768"
USERFS_PARTITION_SIZE = "1024"

BBMASK += " \
    meta-laird-cp/recipes-packages/openssl \
    meta-laird-cp/recipes-packages/.*/.*openssl10.* \
"

PREFERRED_PROVIDER_wpa-supplicant = "sterling-supplicant-lwb"
PREFERRED_PROVIDER_wpa-supplicant-cli = "sterling-supplicant-lwb-cli"
PREFERRED_PROVIDER_wpa-supplicant-passphrase = "sterling-supplicant-lwb-passphrase"
PREFERRED_RPROVIDER_wireless-regdb-static = "wireless-regdb"
```

## conf/layer.conf
```bitbake
# We have a conf and classes directory, add to BBPATH
BBPATH .= ":${LAYERDIR}"

# We have recipes-* directories, add to BBFILES
BBFILES += "${LAYERDIR}/recipes-*/*/*.bb \
            ${LAYERDIR}/recipes-*/*/*.bbappend"

BBFILE_COLLECTIONS += "meta-obc-kernel"
BBFILE_PATTERN_meta-obc-kernel = "^${LAYERDIR}/"
BBFILE_PRIORITY_meta-obc-kernel = "6"

LAYERDEPENDS_meta-obc-kernel = "core"
LAYERSERIES_COMPAT_meta-obc-kernel = "gatesgarth"
```

## conf/machine/qsmp-1530-bb.conf
```bitbake
#@TYPE: Machine
#@NAME: qsmp-1530
#@DESCRIPTION: Machine Configuration for Ka-Ro electronics GmbH's QSMP-1530 CoM

include conf/machine/include/txmp-base.inc

MACHINEOVERRIDES =. "qsmp:qsmp-1530:qsmp-1530-bb:"

# =========================================================================
# U-Boot configs
# =========================================================================
UBOOT_CONFIG[generic]   = "qsmp-1530_defconfig,,u-boot.img"
UBOOT_CONFIG[noenv]   = "qsmp-1530_noenv_defconfig,,u-boot.img"
UBOOT_CONFIG[mfg] = "qsmp-1530_mfg_defconfig,,u-boot.stm32"
UBOOT_CONFIG[trusted] = "qsmp-1530_trusted_defconfig,,u-boot.stm32"

# Trusted Firmware
TF_A_DEVICETREE = "stm32mp153a-qsmp-1530"

# Kernel
KERNEL_DEVICETREE = " \
    stm32mp153a-qsmp-1530-bb.dtb \
"

MACHINE = 'qsmp-1530-bb'
```
